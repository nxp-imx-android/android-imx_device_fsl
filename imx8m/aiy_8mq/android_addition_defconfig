## imx8m/aiy_8mq/android_addition_defconfig
```kconfig
CONFIG_SND_SOC_RT5645=y
CONFIG_MXC_CAMERA_OV5645_MIPI_V2=y
CONFIG_TYPEC_TCPM=n
CONFIG_TYPEC_TCPCI=n
CONFIG_SND_GOOGLE_EDGETPU_CARD=y
```

## imx8m/evk_8mm/android_gki_defconfig
```kconfig
CONFIG_ARCH_MXC=y
CONFIG_SERIAL_IMX=m
CONFIG_SERIAL_IMX_CONSOLE=m
CONFIG_I2C_IMX=m
CONFIG_PINCTRL_IMX8MM=m
CONFIG_MFD_ROHM_BD718XX=m
CONFIG_IMX_LCDIF_CORE=m
CONFIG_DRM_I2C_ADV7511=m
CONFIG_DRM_IMX=m
CONFIG_DRM_IMX_SEC_DSIM=m
CONFIG_DRM_ETNAVIV=m
CONFIG_MMC_SDHCI_ESDHC_IMX=m
CONFIG_ION_CMA_HEAP=m
CONFIG_CLK_IMX8MM=m
# CONFIG_MXC_VPU_MALONE is not set
# CONFIG_MXC_VPU_WINDSOR is not set
# CONFIG_MXC_IMX_DMX_HW is not set
CONFIG_GPIO_MXC=m
CONFIG_IMX2_WDT=m
CONFIG_IMX8M_PM_DOMAINS=m
CONFIG_TOUCHSCREEN_SYNAPTICS_DSX_I2C=m
CONFIG_USB_CHIPIDEA_OF=m
CONFIG_USB_CHIPIDEA=m
CONFIG_TYPEC_TCPCI=m
CONFIG_USB_CHIPIDEA_UDC=y
CONFIG_USB_CHIPIDEA_HOST=y
CONFIG_USB_EHCI_HCD=m
CONFIG_NOP_USB_XCEIV=m

CONFIG_MEDIA_SUPPORT=y
CONFIG_VIDEOBUF2_DMA_CONTIG=y
CONFIG_V4L_PLATFORM_DRIVERS=y
CONFIG_VIDEO_MXC_CAPTURE=m
CONFIG_VIDEO_MXC_CSI_CAMERA=m
CONFIG_MXC_CAMERA_OV5640_MIPI_V2=m
CONFIG_MXC_MIPI_CSI=m

CONFIG_MACH_IMX_BLUETOOTH_RFKILL=m

CONFIG_SND_IMX_SOC=m
CONFIG_SND_SOC_WM8524=m
CONFIG_SND_SIMPLE_CARD=m
CONFIG_SND_SOC_FSL_SAI=m
CONFIG_IMX_SDMA=m
CONFIG_SND_SOC_FSL_MICFIL=m
CONFIG_SND_SOC_IMX_MICFIL=m
CONFIG_SND_SOC_IMX_PCM_DMA=m

CONFIG_MXC_GPU_VIV=m
```

## imx8m/evk_8mp/android_gki_defconfig
```kconfig
CONFIG_ARCH_MXC=y
CONFIG_MXC_CLK=y
CONFIG_CLK_IMX8MP=y
CONFIG_DEVICE_THERMAL=m
CONFIG_IMX8MM_THERMAL=m
# CONFIG_DEVFREQ_THERMAL is not set
CONFIG_IMX8M_PM_DOMAINS=y
CONFIG_PINCTRL_IMX=y
CONFIG_PINCTRL_IMX8MP=y
CONFIG_SERIAL_IMX=y
CONFIG_SERIAL_IMX_CONSOLE=y
CONFIG_IMX2_WDT=y
CONFIG_I2C_IMX=y
CONFIG_REGULATOR_PCA9450=y
CONFIG_PWM_IMX27=y
CONFIG_BACKLIGHT_PWM=y
CONFIG_MMC_SDHCI_ESDHC_IMX=y
CONFIG_ION_CMA_HEAP=m
CONFIG_PHY_FSL_IMX8MP_LVDS=m
CONFIG_PHY_SAMSUNG_HDMI_PHY=y
CONFIG_MXC_GPU_VIV=m
CONFIG_IMX_LCDIF_CORE=m
CONFIG_DRM_I2C_ADV7511=m
CONFIG_DRM_IMX_CDNS_MHDP=m
CONFIG_DRM_IMX8MP_LDB=m
CONFIG_DRM_FSL_IMX_LVDS_BRIDGE=m
CONFIG_DRM_ITE_IT6263=m
CONFIG_DRM_IMX_SEC_DSIM=m
CONFIG_DRM_DW_HDMI_CEC=m
CONFIG_DRM_DW_HDMI_GP_AUDIO=m
CONFIG_DRM_IMX_HDMI=m
CONFIG_DRM_IMX=m
CONFIG_DRM_PANEL_RAYDIUM_RM67191=m
CONFIG_DRM_PANEL_SIMPLE=m
CONFIG_IMX_LCDIFV3_CORE=m
CONFIG_PHY_FSL_IMX8MQ_USB=m
CONFIG_USB_DWC3=m
CONFIG_MEDIA_USB_SUPPORT=y
CONFIG_USB_VIDEO_CLASS=y
CONFIG_USB_XHCI_HCD=m
CONFIG_TYPEC_SWITCH_GPIO=m
CONFIG_TYPEC_TCPCI=m

CONFIG_IMX_SDMA=m
CONFIG_SND_IMX_SOC=m
CONFIG_SND_SOC_IMX_MICFIL=m
CONFIG_SND_SOC_FSL_ASRC=m
CONFIG_SND_SOC_FSL_EASRC=m
CONFIG_SND_SOC_IMX_CDNHDMI=m
CONFIG_SND_SOC_WM8960=m
CONFIG_SND_SOC_FSL_ASOC_CARD=m
CONFIG_SND_SOC_BT_SCO=m
CONFIG_SND_SIMPLE_CARD=m
CONFIG_SND_SOC_FSL_DSP=m
CONFIG_SND_VERBOSE_PROCFS=y

CONFIG_IMX_MBOX=m
CONFIG_I2C_RPBUS=m
CONFIG_SND_SOC_IMX_RPMSG=m
CONFIG_IMX_REMOTEPROC=m

CONFIG_RTC_DRV_SNVS=m

CONFIG_WLAN_VENDOR_NXP=m
CONFIG_MXMWIFIEX=m
CONFIG_TOUCHSCREEN_SYNAPTICS_DSX_I2C=m
CONFIG_KEYBOARD_SNVS_PWRKEY=m
# CONFIG_MXC_VPU_MALONE is not set
# CONFIG_MXC_VPU_WINDSOR is not set
# CONFIG_MXC_IMX_DMX_HW is not set

CONFIG_PHY_FSL_IMX_PCIE=m
CONFIG_PCI_IMX6=m

CONFIG_STAGING_MEDIA=y
CONFIG_VIDEO_OV5640=m
CONFIG_VIDEO_IMX_CAPTURE=m

CONFIG_NET_VENDOR_FREESCALE=y
CONFIG_ETHERNET=y
CONFIG_FEC=m

CONFIG_TRUSTY=m

CONFIG_MXC_HANTRO_VC8000E=m
CONFIG_MXC_HANTRO_845=m

CONFIG_BATTERY_DUMMY=m

CONFIG_RESET_IMX7=m
CONFIG_IMX8M_BUSFREQ=y
CONFIG_IMX_IRQSTEER=y
CONFIG_GPIO_MXC=y
CONFIG_TIMER_IMX_SYS_CTR=y

CONFIG_FPGA=y
CONFIG_INIT_STACK_NONE=y

CONFIG_NVMEM_IMX_OCOTP=m
CONFIG_CPUFREQ_DT=m
CONFIG_ARM_IMX_CPUFREQ_DT=m
```
